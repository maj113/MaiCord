// Generated by tools/generate_emoji_shortcodes.py; do not edit.
// Sources: Unicode emoji-test.txt 16.0 (Unicode License v3), gemoji (MIT) and
// emojibase-data 16.0.3 joypixels, iamcal and emojibase presets (MIT); see the generator.
constexpr char kEmojiShortcodeNames[] =
    "+100-1stormyanmarshall_islandsu7121234u7533rdisg"
    "uisedu7981u7a7arrow_left_hook_womans_hatflag-bee"
    "rswedenmarkiss_tone2flag-bflamerican_samoaflag-b"
    "guatemalawilted_roseflag-bhutanzaniaflag-birthda"
    "yflag-bja_herelaxedflag-blushushedizzy_face_with"
    "_symbols_over_mouthumbsdownflag-bmongoliaflag-bn"
    "o_good_woman-wrestlingflag-boomalaysiaflag-bqfla"
    "g-brazilmao2ndroolingflag-bsmirk_cat2flag-bturke"
    "y_tridentflag-bvsuvhsoccerowing_man_in_business_"
    "suit_levitating_medium_dark_skin_toneflag-bwoozy"
    "flag-byflag-bzambiarrow_upper_leftflag-call_mega"
    "spainnocentral_african_republiclimbing_woman-row"
    "ing-boatflag-ccuracaoflag-cdrum_with_drumsticksf"
    "lag-cfencerace_carrow_backwardflag-cgray_heartpu"
    "lsecond_place_medalflag-cheeserbiarrow_right_hoo"
    "k_person_skiingflag-city_sunsetflag-ckiss_tone3f"
    "lag-clownose_steam_locomotiveflag-cmacedoniaflag"
    "-cnorfolk_islandflag-couchadirect_hitflag-cpinat"
    "aiwanguillarge_brown_circleflag-croatiarrows_cou"
    "nterclockwiseflag-cubambook_mandarinformation_so"
    "urceflag-cvflag-cwhale2flag-cxflag-cyprussiarrow"
    "_lower_left_crayonflag-czechiaflag-dequatorial_g"
    "uineaflag-dguadeloupen_ballpoint_downflag-djibou"
    "tired_octagonal_signflag-dkiss_tone4flag-dmag_ri"
    "ght_fist_left_fist_right_bicepuerto_ricolombiafl"
    "ag-dollsomaliaflag-dzimbabwearyflag-ear_of_rice_"
    "scenext_track_nextflag-ecuadorowing_woman-kiss-m"
    "anflag-eeight_pointed_black_star-struckiss_man_m"
    "an_tone4_tone2flag-egyptriumphotspringsquinting_"
    "faceflag-ehasheepinchileavesurinamedical_maskiss"
    "_man_man_tone4_tone3flag-erailroad_track_previou"
    "s_track_buttonflag-eswazilandflag-etimor_lestewc"
    "urryflag-european_castleflag-fijigsawtfaxrayo-yo"
    "lder_adult_medium_light_skin_toneflag-fjamaicamb"
    "odiamondsierra_leonew_zealand_islandsleeping_acc"
    "ommodationflag-fkiss_tone5flag-fmauritiusweet_po"
    "tatom_symboliviarrow_heading_downflag-football_g"
    "oodflag-frieswatiniflag-gambiarrow_down_smallfla"
    "g-gbruneight_oclock830flag-gdisappointed_relieve"
    "dflag-gemailbox_closed_lock_with_keycap_ten_oclo"
    "ck330flag-gfast_up2flag-gguardswoman-running_man"
    "flag-ghanail_careunionflag-gibraltarrow_up_small"
    "flag-glion_face_with_cowboy_hatflag-gmotorbikefl"
    "ag-gnotepad_spiral_note_padflag-gpistolder_woman"
    "-surfing_manflag-gqflag-grandmayotteflag-gsan_ma"
    "rino_haircut_woman-heart-manflag-gtoilet_papercl"
    "ipsolomon_islandsflag-gunlock_with_ink_pencil2fl"
    "ag-gwhiskyrgyzstanding_person_tone4_baldflag-gyf"
    "lag-hkoala_face_with_open_mouth_vomiting_facefla"
    "g-hmotorboatflag-hno_one_under_18flag-hrotating_"
    "lightflag-hturkmenistanflag-hugspadesktopoundera"
    "geflag-ice_cubentogoalbaniarrow_double_downflag-"
    "idiamond_shape_with_a_dot_insideflag-ieflag-ilit"
    "huaniaflag-imadagascarrow_double_upouting_woman-"
    "kiss-woman-gesturing-okiss_woman_man_tone1_tone2"
    "flag-indonesiaflag-ioflag-iqflag-irangolaosurfer"
    "olling_eyest_vincent_grenadinesflag-israel_salva"
    "doraised_hand_with_fingers_splayedflag-ituxedo_t"
    "one1flag-jerseychellesix_pointed_starslovakiafla"
    "g-jmage_woman-bowing_man_in_business_suit_levita"
    "ting_medium_skin_toneflag-jordancing_menflag-jpo"
    "landorramenorah_with_nine_branchesflag-kenyawnin"
    "gflag-kgiraffe_faceflag-khaitimeritrearth_asiafl"
    "ag-kiribatiger2flag-kmate_drinkiss_man_man_tone3"
    "_tone5flag-knocked_outflag-kpaletteflag-kradioac"
    "tive_signflag-kworriedflag-kyflag-kzipper_mouthe"
    "_hornsleuth_or_spyflag-large_blue_circleflag-lbe"
    "larusarkuwaitunisiaflag-lcomputeregional_indicat"
    "or_xflag-libya_bloodiego_garciaflag-lkissing_hea"
    "rt_eyes_catflag-lraising_hand_manflag-lscream_ca"
    "tflag-ltuxedo_tone2flag-lu5272flag-lvflag-lyflag"
    "-maltadartificial_satellite_orbitalyflag-mconfus"
    "edflag-mdflag-metalgeriarrow_lower_rightflag-mfe"
    "ncingreenlandflag-mgolfing_womans_clothesflag-mh"
    "ankey2flag-mkarate_uniformflag-mliechtensteinfla"
    "g-mmauritaniaflag-mnorthern_mariana_islandsflag-"
    "moyaizakaya_lanternflag-mparkingflag-mqflag-mrac"
    "ing_motorcycleflag-msix_oclock230flag-mtuxedo_to"
    "ne3flag-mute-mailbox_with_mailbox_with_no_mailfl"
    "ag-mvflag-mwolf_face_with_one_eyebrow_raised_eye"
    "browboatwisted_rightwards_arrows_clockwiseflag-m"
    "xflag-myflag-mzombie_woman-swimming_manflag-nafl"
    "ag-ncouple_mmflag-nepalaughingflag-nflag-agrimac"
    "ingflag-ngrey_question_markiss_man_man_tone4_ton"
    "e5flag-niueject_symbolder_adult_light_skin_tonef"
    "lag-nlow_brightnessflag-norwayflag-npuddingflag-"
    "nraising_hand_woman-woman-boy-boyflag-number_sig"
    "nal_strengthumbdownflag-nzflag-omicronesiaflag-p"
    "aellatviarrow_heading_upolar_bear_faceflag-peeko"
    "kosovoflag-pflag-ai_love_you_hand_signflag-pgrey"
    "_exclamation_questionflag-philippinesad_relieved"
    "_faceflag-pkneeling_woman_tone2_bearded_person_m"
    "edium_light_skin_toneflag-play_pauserious_face_w"
    "ith_symbols_covering_mouthermometer_faceflag-pmi"
    "lk_glasswimming_woman_tone4_beardflag-pnflag-pra"
    "yumoroccomorosassy_man_in_business_suit_levitati"
    "ng_dark_skin_toneflag-psoft_serveflag-ptuxedo_to"
    "ne4flag-pwrestlerspace_invaderelict_house_buildi"
    "ngsflag-pyflag-qatarubahamassage_woman-shrugging"
    "ermanyflag-rewind_blowing_faceflag-romaniaflag-r"
    "spock-handicappedflag-running_woman_with_bearded"
    "_person_medium_skin_toneflag-rwandatears_of_joy_"
    "catflag-saladybugflag-sbelgiuminidisco_ballflag-"
    "sdflag-senegalower_left_fountain_pensiveflag-sgr"
    "inning_face_with_star_eyesflag-shuffleur-de-lisu"
    "pervillain_woman_running_rightflag-sickazakhstan"
    "ding_woman_tone3_beardflag-sjuggleregional_indic"
    "ator_rflag-skeletongabono_good_manflag-slideogra"
    "ph_advantageflag-smokingflag-sneezebra_faceflag-"
    "sobulburmacao_bloodflag-sri_lankayakiss_tone1fla"
    "g-sswim_brieflag-bahrainyflag-st_luciaflag-svalb"
    "ard_jan_mayenflag-sxflag-syriab_bloodflag-szflag"
    "-tajikistanguishedflag-tcouple_wwhite_exclamatio"
    "nflag-tdflag-tflag-alifebuoyflag-tgrinning_cat_w"
    "ith_closed_eyesflag-thumbupoint_left-facing_fist"
    "_raised_handshake_tone1_tone2flag-tja_secretflag"
    "-tkneeling_person_tone3_bald_person_bearded_pers"
    "on_light_skin_toneflag-tlarge_green_squaregional"
    "_indicator_gflag-tmontenegrobot_face_with_finger"
    "_covering_closed_lipsflag-tnflag-toolsloveniafla"
    "g-trexhalebanon-potable_water_poloopig2flag-ttux"
    "edo_tone5flag-tvflag-two_oclock430flag-tzflag-ua"
    "flag-ugandagger_knife_fork_plateflag-umontserrat"
    "flag-unicorn_faceflag-us_virgin_islandsflag-uyfl"
    "ag-uzbekistanger_right-facing_fist_oncomingflag-"
    "vanuatuvaluxembourgflag-vcold_sweat_dropsao_tome"
    "_principerson_tone2_red_haired_woman-gesturing-n"
    "o_mouthinkingflag-veflag-vgrinning_face_with_clo"
    "sed_eyesflag-victoryflag-vnflag-vulcanadashitick"
    "etshirtrashcanary_islandsmiling_face_with_closed"
    "_eyesflag-wflag-amoneybagflag-wsassy_woman_beard"
    "ed_person_dark_skin_toneflag-xkissing_closed_eye"
    "sflag-yemenorth_korearth_european_unionflag-ytra"
    "ffic_lightflag-zappleadingflag-zmozambiqueflag-z"
    "watery_eyescreaming_in_fearfull_moon_with_facefl"
    "ag_aconfoundedflag_adflag_aeflag_aflag-aoflag_ag"
    "rinning_face_with_one_large_and_one_small_eye_sp"
    "eech_bubbleflag_aiflag_alarge_orange_circleflag_"
    "amale_dancersatisfiedflag_aoflag_aqflag_armeniar"
    "row_upper_rightflag_ascension_islandflag_athleti"
    "c_shoeflag_au5408ballot_box_with_checkered_flag-"
    "aclapperunnerdizzy_eyespeak_no_evilflag_awalking"
    "_woman-heart-woman-raising-handshake_tone2_tone1"
    "flag_axflag_azflag_bathroomflag_bburundividersin"
    "t_maartenflag_bdflag_benine_oclock730flag_bflag-"
    "aqflag_bgflag_bhoorayflag_billiardsouth_africaym"
    "an_islandsmiling_face_with_three_heartsflag_bjap"
    "an_mapolicewoman-walking_manflag_bmicrophone2fla"
    "g_bnflag_botswanaflag_bqflag_bricksneezingflag_b"
    "saudiarabiaflag_btrinidad_tobagolferacehorseven_"
    "oclock930flag_bvflag_bwallis_futunamusedflag_byf"
    "lag_bzflag_callinguernseye-in-speech-bubbleflag_"
    "ccontrolleregional_indicator_zflag_cdflag_cflag-"
    "archeryflag_cgflag_champagne_glassflag_city_sunr"
    "iseflag_ckissing_smiling_eyesflag_clubscooteregi"
    "onal_indicator_sflag_cmoney_mouthumbsuperhero_wo"
    "man_with_turbandaidove_of_peaceflag_cnflag_coffe"
    "ethiopiaflag_cpakistanding_manflag_cqflag_cruise"
    "_shippoopourhinotescorpiuslight_smileflag_cupid_"
    "card_boxing_glovesmiling_face_with_3_heartsflag_"
    "cvflag_cweight_lifterflag_cxflag_cyflag_czech_re"
    "publice_hockey_stick_and_puckiss_woman_man_tone1"
    "_tone5flag_deflag_dgflag_djuice_boxflag_dkiss_ma"
    "n_man_tone1_tone3flag_dmonocle_faceflag_dollarge"
    "_red_squaregional_indicator_couplekiss_wweight_l"
    "ifting_manflag_dzflag_earth_africapital_abcdflag"
    "_ecosta_ricamera_flashopping_trolleyflag_eeflag_"
    "egflag_ehotdog2flag_eregional_indicator_kiss_wom"
    "an_man_tone1_tone3flag_esauna_womans_sandalflag_"
    "etipping_hand_manflag_european_post_officelandfl"
    "ag_finlandroido_not_litter_binflag_fja_bargainfo"
    "rmation_desk_person_tone1_red_haired_manflag_fki"
    "ss_man_man_tone1_tone4flag_fmortar_boardflag_fox"
    "_face_palm_upside_downflag_francensored_caribbea"
    "n_netherlandsflag_gay_pride_flag-adromedary_came"
    "lt-rexhalingflag_gdflag_genie_woman-pouting_manf"
    "lag_gflag-astonishedflag_ggflag_ghondurasleeping"
    "_bedflag_gift_heartbeatflag_glarge_orange_square"
    "gional_indicator_hammer_pickiss_man_man_tone4_to"
    "ne1flag_gmostly_sunnyflag_gnflag_gparaguayflag_g"
    "qflag_grenadaflag_gsmiling_impoint_forwardflag_g"
    "tristan_da_cunhalolder_man_with_chinese_cape_ver"
    "deflag_guyanauseatedflag_gwry_smile_catflag_gyfl"
    "ag_hkiss_man_man_tone1_tone5flag_hmoon_ceremonyf"
    "lag_hnflag_hregional_indicator_lflag_hthunder_cl"
    "oud_rainflag_hungaryflag_icecreamflag_idflag_ief"
    "lag_ilarge_purple_circleflag_imother_christmas_i"
    "slandflag_interrobangbangladeshelled_peanutflag_"
    "ioflag_iqflag_iraquiet_soundflag_isle_of_manflag"
    "_itipping_hand_woman_walking_rightflag_jeflag_jm"
    "obile_phone_arrow_forwardflag_jolly_rogeraised_h"
    "and_with_part_between_middle_and_ring_fingersfla"
    "g_jportugalast_quarter_moon_with_faceflag_keycap"
    "_star2flag_kgflag_khigh_five_oclock530flag_kiwif"
    "ruitflag_kmountain_bicyclist_barthelemyflag_knee"
    "ling_manflag_kpalm_downflag_kregional_indicator_"
    "mflag_kwestern_saharabbit2flag_kyflag_kzflag_lar"
    "ge_blue_squaregional_indicator_dflag_lbusstophat"
    "ched_chicken_faceflag_lcompressionflag_liberiafl"
    "ag_lkiss_man_man_tone2_tone1flag_lregional_indic"
    "ator_nflag_lsouth_korearth_americasmiling_face_w"
    "ith_smiling_eyes_and_hand_covering_mouthird_plac"
    "e_medal_militaryflag_ltipping_hand_person_runnin"
    "g_rightflag_lu55b6flag_lvflag_lyflag_mahjongflag"
    "_mcouple_kiss_mwaving_white_flag-afghanistanxiou"
    "s_faceflag_mdflag_mexicopen_umbrella2flag_mflag-"
    "atmoldovampire_woman-facepalmingflag_mgflag_mhig"
    "h_heeleven_oclock1130flag_mkiss_man_man_tone2_to"
    "ne3flag_mlarge_purple_squaregional_indicator_ifl"
    "ag_mmouse_three_button_mouse2flag_mnflag_monacow"
    "2flag_mpoliceman_and_woman_holding_handshake_ton"
    "e1_tone5flag_mqflag_mregional_indicator_oflag_ms"
    "outh_sudancing_womens_roomflag_mturks_caicos_isl"
    "andsflag_musclevitateflag_mvflag_mworship_symbol"
    "der_adult_medium_skin_toneflag_mxflag_myflag_mzf"
    "lag_naflag_ncowboy_faceflag_neutralower_left_pai"
    "ntbrushocked_face_with_exploding_headphonestonia"
    "flag_nflag-australiaflag_ngflag_nigeriaflag_nlar"
    "ge_yellow_circleflag_no_bellhopouchinauruguayfla"
    "g_npanda_face_with_open_eyes_hand_over_mouthree_"
    "oclock1030flag_nregional_indicator_papua_new_gui"
    "nea_bissauna_man_in_business_suit_levitating_lig"
    "ht_skin_toneflag_nu6307flag_nzflag_omountain_bik"
    "ing_manflag_panamacaustriangular_flag_on_post_pi"
    "erre_miquelonflag_penguin_faceflag_pflag-awavene"
    "zuelarge_brown_squaregional_indicator_flag-bbeli"
    "zeroflangelf_womans_bootflag_pgflag_phong_kongfl"
    "ag_pkiss_man_man_tone2_tone4flag_plarge_yellow_s"
    "quaregional_indicator_ja_reservedflag_pmountain_"
    "biking_woman-lifting-weightsflag_pnflag_projecto"
    "regional_indicator_yflag_pspeech_leftwards_arrow"
    "_with_hookiss_woman_man_tone2_tone1flag_ptwo_men"
    "_holding_handshake_tone1_tone4flag_pwhite_sun_cl"
    "oud_lightning_cloud_tornado_cloud_snowyflag_pyfl"
    "ag_qaflag_recycleflag_royaltyflag_rsweat_smiley_"
    "catflag_running_shirt_with_sashearing_aidflag_rw"
    "hite_check_markiss_man_man_tone5_tone3flag_santa"
    "rcticameroonflag_sbeginneregional_indicator_whit"
    "e_sun_rain_cloudsun_and_rainbow-flagspeakeregion"
    "al_indicator_u6e80flag_scalesothochomeswimmeregi"
    "onal_indicator_vflag_sdflag_see_no_evilflag_sgfl"
    "ag_shaking_handshake_tone1_tone3flag_singaporegi"
    "onal_indicator_aflag_sja_vacancyflag_skull_cross"
    "bonesflag_sleepyflag_smirkingflag_sneakeregional"
    "_indicator_tflag_sosaturno_entry_signflag_sregio"
    "nal_indicator_qflag_sswitzerlandflag_st_helenafl"
    "ag_svflag_sxflag_syflag_szflag_taflag_tclimbing_"
    "manflag_tdflag_tflag-ax-rayflag_tgflag_thailandf"
    "lag_tja_discountflag_tkiss_man_man_tone2_tone5fl"
    "ag_tlotus_position_woman-getting-haircut_manflag"
    "_tmflag_tnflag_tokelau6709flag_train2flag_tthund"
    "er_cloud_and_rainflag_tvflag_twelve_oclock1230fl"
    "ag_tzflag_uaflag_ugflag_umflag_united_statestuck"
    "_out_tongue_winking_eyeglassesurfing_womans_flat"
    "_shoeflag_us_outlying_islandsflag_uyflag_uzflag_"
    "vatican_city_duskiss_man_man_tone3_tone2flag_vco"
    "te_divoirelandflag_veflag_vgflag_vietnamibiaflag"
    "_vnflag_vu6708flag_wflag-azerbaijangry_impoint_r"
    "ightwards_arrow_with_hookiss_woman_man_tone2_ton"
    "e3flag_wsaudi_arabiaflag_xkiss_man_man_tone3_ton"
    "e1flag_yeflag_ytwo_women_holding_hands_tone1_ton"
    "e2flag_zanyflag_zmflag_zwaving_black_flag-aexpec"
    "ting_woman_tone5_beardflipperseverepeat_one-piec"
    "e_swimsuitflushedukrainewspaper2fuelpumpoint_up_"
    "2fast_downcast_facefried_eggfrog_face_with_eye_b"
    "agsfamily_accursing_facefamily_mbblue_carrow_up_"
    "downfamily_mgbulgariafamily_mggfamily_wbbird_fac"
    "epunchart_with_upwards_trendfamily_wgboba_drinki"
    "ss_man_man_tone3_tone4family_wggfemale_elf_mans_"
    "shoefilm_striphone_oclock130flag-waleschool_satc"
    "helmet_with_white_crossflag_black_jokerescue_wor"
    "ker_helmet_with_crossflag_gbengflag_gbsctflag_gb"
    "wlsqueeze_bottleflag_white_questionfairy_woman-g"
    "olfing_manfamily_aaccocos_islandspeaking_head_in"
    "_silhouettefamily_mmbback_of_hand_splayedfamily_"
    "mmgbeaming_facefamily_mmggfamily_mwbblonde_woman"
    "-frowning2family_mwgbowing_woman-juggling_person"
    "_tone2_bald_woman-bikingfamily_mwggfamily_wwbbur"
    "kina_fasoono_soundfamily_wwgbouvet_islandfamily_"
    "wwggfemale-cook_islandsnowman_with_snow_cloudyfe"
    "male_mage_man-man-girl-boyfolding_fantigua_barbu"
    "dafour_oclock630frame_photoo_coolder_adult_dark_"
    "skin_tonew_moon_with_facehigh_volumefast_forward"
    "fast_reversed_hand_with_middle_finger_extendedfe"
    "male-guardsman_with_gua_pi_maofemale-judgefemale"
    "-pilotus_position_manfemale_fairy_man-man-girl-g"
    "irlfemale_genie_mantlepiece_clockiss_man_man_ton"
    "e5_tone4flag-englandfrench_breadhamster_facehead"
    "_bandagehear_no_evilhugging_facefaroe_islandstuc"
    "k_out_tongue_closed_eyesfemale-artist_martinique"
    "female-doctorfemale-farmerfemale-singerfemale_zo"
    "mbie_man_in_business_suit_levitating_medium_ligh"
    "t_skin_toneflag-scotlandfrench_guianaja_acceptab"
    "le_tennis_paddle_and_ballja_no_vacancyja_prohibi"
    "tedjapanese_ogreeceuta_melillarge_green_circlebe"
    "ach_umbrella_with_rainbiohazard_signblowing_a_ki"
    "ss_wmbreast-feedingclinking_glassouth_georgia_so"
    "uth_sandwich_islandscongo_kinshasalutexpressionl"
    "essfemale-studentfemale-teacherfemale_vampire_ma"
    "nflight_arrivalfrowning_woman_tone1_bearded_pers"
    "on_medium_dark_skin_toneja_applicationunited_kin"
    "gdominican_republicouplekiss_mmunited_nationsbri"
    "de_with_veilcalendar_spiral_calendar_padcrying_c"
    "at_facefemale-mechanicaraguamaldiveslight_frowni"
    "ng_manfrowning_person_with_ballheavy_plus_signhi"
    "gh_brightnesshouse_abandonedjapanese_goblinbaske"
    "tball_woman-cartwheelingblond-haired-manbullettr"
    "ain_sidecricket_bat_ballfalkland_islandsfemale-a"
    "stronautfemale-detectivefemale-scientistuffed_pi"
    "tafemale_detectivefemale_superhero_manflight_dep"
    "arturegional_indicator_basketball_manfork_knife_"
    "plate_with_cutleryfrench_polynesiaheavy_check_ma"
    "rkiss_man_man_tone5_tone2heavy_minus_signja_pass"
    "ing_gradebasketball_playerbouncing_ball_manbulle"
    "ttrain_frontclipperton_islandcongo_brazzavilleco"
    "nstruction_sitefirst_place_medal_sportstaff_of_a"
    "esculapiusja_free_of_chargentinaja_monthly_amoun"
    "tain_snowman2ja_service_chargeparasol_on_groundp"
    "artly_sunny_rainblond-haired-woman-tipping-hands"
    "hake_tone2_tone3bosnia_herzegovinacouplekiss_man"
    "_man_tone1_tone2female-firefighterframe_with_pic"
    "turegional_indicator_eja_congratulationsblond_ha"
    "ired_person_with_turbanbouncing_ball_woman-woman"
    "-girl-boyfemale-technologist_kitts_nevisfemale_s"
    "upervillain_manheavy_division_signbouncing_ball_"
    "person_kneeling_rightcouple_with_heart_mmcouple_"
    "with_heart_mwhite_frowning_facecouple_with_heart"
    "_wmcouple_with_heart_wweight_lifting_woman-getti"
    "ng-massage_mancouplekiss_man_woman_kneeling_righ"
    "tcricket_bat_and_ballfemale-office-workerja_not_"
    "free_of_cargeja_open_for_businessunited_arab_emi"
    "ratesblack_square_for_stopitcairn_islandsfemale-"
    "factory-workerfemale-police-officerfishing_pole_"
    "and_fish_cakeycap_asteriskiss_man_man_tone5_tone"
    "1handshake_tone2_tone4handshake_tone2_tone5hands"
    "hake_tone3_tone1handshake_tone3_tone2handshake_t"
    "one3_tone4handshake_tone3_tone5handshake_tone4_t"
    "one1handshake_tone4_tone2handshake_tone4_tone3ha"
    "ndshake_tone4_tone5handshake_tone5_tone1handshak"
    "e_tone5_tone2handshake_tone5_tone3handshake_tone"
    "5_tone4person_tone3_red_haired_person_tone5_bald"
    "person_tone4_red_hairplane_small_red_triangle_do"
    "wnperson_tone5_red_hairplane_arrivingperson_with"
    "_headscarflag-bdouble_exclamationwhite_sun_small"
    "_cloud_with_tornadouble_helixwoman-woman-girl-gi"
    "rlbritish_virgin_islandscouplekiss_woman_woman_t"
    "one1_tone2heard_mcdonald_islandsheavy_exclamatio"
    "n_markiss_woman_man_tone1_tone4heavy_multiplicat"
    "ion_xhourglass_flowing_sandperson_doing_cartwhee"
    "lperson_with_blond_haired_woman_blond_haired_man"
    "woman-playing-handball_person_tone1_bald_man-man"
    "-boy-boyblack_circle_for_recordconstruction_work"
    "er_manpalestinian_territoriesperson_tone1_curly_"
    "haired_manperson_tone1_white_haired_manperson_to"
    "ne2_curly_haired_woman-bouncing-ballperson_tone2"
    "_white_haired_woman-wearing-turbanperson_tone3_c"
    "urly_haired_person_snowboardingperson_tone3_whit"
    "e_haired_person_walking_rightperson_tone4_curly_"
    "hairperson_tone4_white_hairperson_tone5_curly_ha"
    "irperson_tone5_white_hairput_litter_in_its_place"
    "person_with_pouting_facewoman-playing-water-polo"
    "w_volumedium_volumnew_caledoniaconstruction_work"
    "er_woman-mountain-bikingwoman_bald_dark_skin_ton"
    "ewspaper_roll_eyesavoring_foodchart_with_downwar"
    "ds_trendfemale-construction-workerkiss_woman_man"
    "_tone2_tone5kiss_woman_man_tone3_tone1kiss_woman"
    "_man_tone3_tone2kiss_woman_man_tone3_tone4kiss_w"
    "oman_man_tone3_tone5kiss_woman_man_tone4_tone1ki"
    "ss_woman_man_tone4_tone2kiss_woman_man_tone4_ton"
    "e3kiss_woman_man_tone4_tone5kiss_woman_man_tone5"
    "_tone1kiss_woman_man_tone5_tone2kiss_woman_man_t"
    "one5_tone3kiss_woman_man_tone5_tone4white_sun_wi"
    "th_small_cloud_soundwoman_bald_light_skin_tonega"
    "tive_squared_cross_markiss_woman_man_tone2_tone4"
    "field_hockey_stick_and_ballfrench_southern_terri"
    "torieswoman_bald_medium_skin_tonewoman_with_whit"
    "e_cane_rightfirst_quarter_moon_with_facekiss_wom"
    "an_woman_tone1_tone3kiss_woman_woman_tone1_tone4"
    "kiss_woman_woman_tone1_tone5kiss_woman_woman_ton"
    "e2_tone1kiss_woman_woman_tone2_tone3kiss_woman_w"
    "oman_tone2_tone4kiss_woman_woman_tone2_tone5kiss"
    "_woman_woman_tone3_tone1kiss_woman_woman_tone3_t"
    "one2kiss_woman_woman_tone3_tone4kiss_woman_woman"
    "_tone3_tone5kiss_woman_woman_tone4_tone1kiss_wom"
    "an_woman_tone4_tone2kiss_woman_woman_tone4_tone3"
    "kiss_woman_woman_tone4_tone5kiss_woman_woman_ton"
    "e5_tone1kiss_woman_woman_tone5_tone2kiss_woman_w"
    "oman_tone5_tone3kiss_woman_woman_tone5_tone4pers"
    "on_with_white_cane_rightbritish_indian_ocean_ter"
    "ritorykiss_person_person_tone1_tone2kiss_person_"
    "person_tone1_tone3kiss_person_person_tone1_tone4"
    "kiss_person_person_tone1_tone5kiss_person_person"
    "_tone2_tone1kiss_person_person_tone2_tone3kiss_p"
    "erson_person_tone2_tone4kiss_person_person_tone2"
    "_tone5kiss_person_person_tone3_tone1kiss_person_"
    "person_tone3_tone2kiss_person_person_tone3_tone4"
    "kiss_person_person_tone3_tone5kiss_person_person"
    "_tone4_tone1kiss_person_person_tone4_tone2kiss_p"
    "erson_person_tone4_tone3kiss_person_person_tone4"
    "_tone5kiss_person_person_tone5_tone1kiss_person_"
    "person_tone5_tone2kiss_person_person_tone5_tone3"
    "kiss_person_person_tone5_tone4woman-with-bunny-e"
    "ars-partyingwomen-with-bunny-ears-partyingwomen_"
    "with_bunny_ears_partyingblond-haired_man_dark_sk"
    "in_tonepeople_with_bunny_ears_partyingwoman_red_"
    "haired_dark_skin_tonewomen_holding_hands_tone1_t"
    "one3women_holding_hands_tone1_tone4women_holding"
    "_hands_tone1_tone5women_holding_hands_tone2_tone"
    "1women_holding_hands_tone2_tone3women_holding_ha"
    "nds_tone2_tone4women_holding_hands_tone2_tone5wo"
    "men_holding_hands_tone3_tone1women_holding_hands"
    "_tone3_tone2women_holding_hands_tone3_tone4women"
    "_holding_hands_tone3_tone5women_holding_hands_to"
    "ne4_tone1women_holding_hands_tone4_tone2women_ho"
    "lding_hands_tone4_tone3women_holding_hands_tone4"
    "_tone5women_holding_hands_tone5_tone1women_holdi"
    "ng_hands_tone5_tone2women_holding_hands_tone5_to"
    "ne3women_holding_hands_tone5_tone4blond-haired_m"
    "an_light_skin_tonepeople_holding_hands_tone1_ton"
    "e2people_holding_hands_tone1_tone3people_holding"
    "_hands_tone1_tone4people_holding_hands_tone1_ton"
    "e5people_holding_hands_tone2_tone1people_holding"
    "_hands_tone2_tone3people_holding_hands_tone2_ton"
    "e4people_holding_hands_tone2_tone5people_holding"
    "_hands_tone3_tone1people_holding_hands_tone3_ton"
    "e2people_holding_hands_tone3_tone4people_holding"
    "_hands_tone3_tone5people_holding_hands_tone4_ton"
    "e1people_holding_hands_tone4_tone2people_holding"
    "_hands_tone4_tone3people_holding_hands_tone4_ton"
    "e5people_holding_hands_tone5_tone1people_holding"
    "_hands_tone5_tone2people_holding_hands_tone5_ton"
    "e3people_holding_hands_tone5_tone4white_sun_behi"
    "nd_cloud_with_rainwoman_bald_medium_dark_skin_to"
    "newoman_in_manual_wheelchair_rightwoman_red_hair"
    "ed_light_skin_tonebadminton_racquet_and_shuttlec"
    "ocktailower_left_ballpoint_pen_fountainblond-hai"
    "red_man_medium_skin_toneblond-haired_woman_dark_"
    "skin_toneperson_in_manual_wheelchair_rightwoman_"
    "bald_medium_light_skin_tonewoman_curly_haired_da"
    "rk_skin_tonewoman_red_haired_medium_skin_tonewom"
    "an_white_haired_dark_skin_toneblond-haired_woman"
    "_light_skin_tonewoman_curly_haired_light_skin_to"
    "newoman_white_haired_light_skin_toneblond-haired"
    "_woman_medium_skin_tonewoman_curly_haired_medium"
    "_skin_tonewoman_in_motorized_wheelchair_rightwom"
    "an_white_haired_medium_skin_toneperson_in_motori"
    "zed_wheelchair_rightcouple_with_heart_man_man_to"
    "ne1_tone2couple_with_heart_man_man_tone1_tone3co"
    "uple_with_heart_man_man_tone1_tone4couple_with_h"
    "eart_man_man_tone1_tone5couple_with_heart_man_ma"
    "n_tone2_tone1couple_with_heart_man_man_tone2_ton"
    "e3couple_with_heart_man_man_tone2_tone4couple_wi"
    "th_heart_man_man_tone2_tone5couple_with_heart_ma"
    "n_man_tone3_tone1couple_with_heart_man_man_tone3"
    "_tone2couple_with_heart_man_man_tone3_tone4coupl"
    "e_with_heart_man_man_tone3_tone5couple_with_hear"
    "t_man_man_tone4_tone1couple_with_heart_man_man_t"
    "one4_tone2couple_with_heart_man_man_tone4_tone3c"
    "ouple_with_heart_man_man_tone4_tone5couple_with_"
    "heart_man_man_tone5_tone1couple_with_heart_man_m"
    "an_tone5_tone2couple_with_heart_man_man_tone5_to"
    "ne3couple_with_heart_man_man_tone5_tone4heavy_he"
    "art_exclamation_mark_ornamentblond-haired_man_me"
    "dium_dark_skin_tonewoman_red_haired_medium_dark_"
    "skin_tonewoman_with_probing_cane_dark_skin_toneb"
    "lond-haired_man_medium_light_skin_tonecouple_wit"
    "h_heart_woman_man_tone1_tone2couple_with_heart_w"
    "oman_man_tone1_tone3couple_with_heart_woman_man_"
    "tone1_tone4couple_with_heart_woman_man_tone1_ton"
    "e5couple_with_heart_woman_man_tone2_tone1couple_"
    "with_heart_woman_man_tone2_tone3couple_with_hear"
    "t_woman_man_tone2_tone4couple_with_heart_woman_m"
    "an_tone2_tone5couple_with_heart_woman_man_tone3_"
    "tone1couple_with_heart_woman_man_tone3_tone2coup"
    "le_with_heart_woman_man_tone3_tone4couple_with_h"
    "eart_woman_man_tone3_tone5couple_with_heart_woma"
    "n_man_tone4_tone1couple_with_heart_woman_man_ton"
    "e4_tone2couple_with_heart_woman_man_tone4_tone3c"
    "ouple_with_heart_woman_man_tone4_tone5couple_wit"
    "h_heart_woman_man_tone5_tone1couple_with_heart_w"
    "oman_man_tone5_tone2couple_with_heart_woman_man_"
    "tone5_tone3couple_with_heart_woman_man_tone5_ton"
    "e4person_with_probing_cane_dark_skin_tonewoman_a"
    "nd_man_holding_hands_tone1_tone2woman_and_man_ho"
    "lding_hands_tone1_tone3woman_and_man_holding_han"
    "ds_tone1_tone4woman_and_man_holding_hands_tone1_"
    "tone5woman_and_man_holding_hands_tone2_tone1woma"
    "n_and_man_holding_hands_tone2_tone3woman_and_man"
    "_holding_hands_tone2_tone4woman_and_man_holding_"
    "hands_tone2_tone5woman_and_man_holding_hands_ton"
    "e3_tone1woman_and_man_holding_hands_tone3_tone2w"
    "oman_and_man_holding_hands_tone3_tone4woman_and_"
    "man_holding_hands_tone3_tone5woman_and_man_holdi"
    "ng_hands_tone4_tone1woman_and_man_holding_hands_"
    "tone4_tone2woman_and_man_holding_hands_tone4_ton"
    "e3woman_and_man_holding_hands_tone4_tone5woman_a"
    "nd_man_holding_hands_tone5_tone1woman_and_man_ho"
    "lding_hands_tone5_tone2woman_and_man_holding_han"
    "ds_tone5_tone3woman_and_man_holding_hands_tone5_"
    "tone4woman_red_haired_medium_light_skin_tonewoma"
    "n_with_probing_cane_light_skin_toneblond-haired_"
    "woman_medium_dark_skin_toneperson_with_probing_c"
    "ane_light_skin_tonewoman_curly_haired_medium_dar"
    "k_skin_tonewoman_white_haired_medium_dark_skin_t"
    "onewoman_with_probing_cane_medium_skin_toneblond"
    "-haired_woman_medium_light_skin_tonecouple_with_"
    "heart_woman_woman_tone1_tone2couple_with_heart_w"
    "oman_woman_tone1_tone3couple_with_heart_woman_wo"
    "man_tone1_tone4couple_with_heart_woman_woman_ton"
    "e1_tone5couple_with_heart_woman_woman_tone2_tone"
    "1couple_with_heart_woman_woman_tone2_tone3couple"
    "_with_heart_woman_woman_tone2_tone4couple_with_h"
    "eart_woman_woman_tone2_tone5couple_with_heart_wo"
    "man_woman_tone3_tone1couple_with_heart_woman_wom"
    "an_tone3_tone2couple_with_heart_woman_woman_tone"
    "3_tone4couple_with_heart_woman_woman_tone3_tone5"
    "couple_with_heart_woman_woman_tone4_tone1couple_"
    "with_heart_woman_woman_tone4_tone2couple_with_he"
    "art_woman_woman_tone4_tone3couple_with_heart_wom"
    "an_woman_tone4_tone5couple_with_heart_woman_woma"
    "n_tone5_tone1couple_with_heart_woman_woman_tone5"
    "_tone2couple_with_heart_woman_woman_tone5_tone3c"
    "ouple_with_heart_woman_woman_tone5_tone4hand_wit"
    "h_index_and_middle_finger_crossedperson_with_pro"
    "bing_cane_medium_skin_tonewoman_curly_haired_med"
    "ium_light_skin_tonewoman_getting_face_massage_da"
    "rk_skin_tonewoman_white_haired_medium_light_skin"
    "_tonehand_with_index_and_middle_fingers_crossedw"
    "oman_getting_face_massage_light_skin_tonecouple_"
    "with_heart_person_person_tone1_tone2couple_with_"
    "heart_person_person_tone1_tone3couple_with_heart"
    "_person_person_tone1_tone4couple_with_heart_pers"
    "on_person_tone1_tone5couple_with_heart_person_pe"
    "rson_tone2_tone1couple_with_heart_person_person_"
    "tone2_tone3couple_with_heart_person_person_tone2"
    "_tone4couple_with_heart_person_person_tone2_tone"
    "5couple_with_heart_person_person_tone3_tone1coup"
    "le_with_heart_person_person_tone3_tone2couple_wi"
    "th_heart_person_person_tone3_tone4couple_with_he"
    "art_person_person_tone3_tone5couple_with_heart_p"
    "erson_person_tone4_tone1couple_with_heart_person"
    "_person_tone4_tone2couple_with_heart_person_pers"
    "on_tone4_tone3couple_with_heart_person_person_to"
    "ne4_tone5couple_with_heart_person_person_tone5_t"
    "one1couple_with_heart_person_person_tone5_tone2c"
    "ouple_with_heart_person_person_tone5_tone3couple"
    "_with_heart_person_person_tone5_tone4woman_getti"
    "ng_face_massage_medium_skin_tonewoman_with_probi"
    "ng_cane_medium_dark_skin_toneperson_with_probing"
    "_cane_medium_dark_skin_tonewoman_with_probing_ca"
    "ne_medium_light_skin_toneperson_with_probing_can"
    "e_medium_light_skin_tonewoman_getting_face_massa"
    "ge_medium_dark_skin_tonewoman_getting_face_massa"
    "ge_medium_light_skin_toneblack_left_pointing_dou"
    "ble_triangle_with_vertical_barbermudark_sunglass"
    "es_coolder_adult_medium_dark_skin_toneblack_righ"
    "t_pointing_double_triangle_with_vertical_barbado"
    "sauna_person_cartwheelblack_right_pointing_trian"
    "gle_with_double_vertical_barely_sunny";
constexpr char kEmojiShortcodeGlyphs[] =
    "\342\214\232\342\214\233\342\217\251\342\217\252\342\217\253\342\217\254\342\217\260\342\217\263\342\227\275\342\227\276\342\230\224\342\230\225\342\231\210\342\231\211\342\231\212\342\231\213"
    "\342\231\214\342\231\215\342\231\216\342\231\217\342\231\220\342\231\221\342\231\222\342\231\223\342\231\277\342\232\223\342\232\241\342\232\252\342\232\253\342\232\275\342\232\276\342\233\204"
    "\342\233\205\342\233\216\342\233\224\342\233\252\342\233\262\342\233\263\342\233\265\342\233\272\342\233\275\342\234\205\342\234\250\342\235\214\342\235\216\342\235\223\342\235\224\342\235\225"
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    "\215\342\235\244\357\270\217\342\200\215\360\237\222\213\342\200\215\360\237\247\221\360\237\217\275\342\200\215\360\237\224\254\360\237\247\221\360\237\217\277\342\200\215\342\235\244\357\270"
    "\217\342\200\215\360\237\222\213\342\200\215\360\237\247\221\360\237\217\276\342\200\215\360\237\224\254";
constexpr EmojiAliasEntry kEmojiShortcodes[] = {
    {0, 7238, 2, 4},
    {4, 7278, 2, 4},
    {1, 1507, 3, 4},
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    {6431, 6286, 2, 8},
};
constexpr u16 kEmojiPrimaryShortcodes[] = {
    1284, 2347, 2345, 1283, 1613, 2442, 2236, 1459, 2339, 2584, 2653, 190, 1414, 2349, 1348, 1571,
    1569, 2218, 1570, 1572, 2816, 2417, 2419, 2418, 1884, 1389, 2477, 2824, 573, 1962, 2354, 2574,
    2238, 1282, 2219, 2037, 2335, 2332, 1822, 2476, 1342, 506, 450, 2424, 1932, 337, 2797, 2338,
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    2614,
};
